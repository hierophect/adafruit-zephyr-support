## boards/adafruit/feather_rp2350/Kconfig.feather_rp2350
```kconfig
# SPDX-License-Identifier: Apache-2.0
# SPDX-FileCopyrightText: Copyright 2025 Sam Blenny

config BOARD_FEATHER_RP2350
	select SOC_RP2350A_M33
```

## boards/adafruit/feather_rp2350/board.yml
```yaml
board:
  name: feather_rp2350
  full_name: Adafruit Feather RP2350
  vendor: adafruit
  socs:
  - name: rp2350a
```

## boards/adafruit_plank/Kconfig.adafruit_plank
```kconfig
# Copyright (c) 2020 Lucian Copeland for Adafruit Industries
# SPDX-License-Identifier: Apache-2.0

config BOARD_ADAFRUIT_PLANK
	select SOC_STM32F405XX
```

## boards/adafruit_plank/board.yml
```yaml
board:
  name: adafruit_plank
  full_name: Feather STM32F405 Express
  vendor: adafruit
  socs:
    - name: stm32f405xx
```

## boards/foo/Kconfig.foo
```kconfig
# Copyright (c) 2020 Lucian Copeland for Adafruit Industries
# SPDX-License-Identifier: Apache-2.0

config BOARD_FOO
	select SOC_STM32F405XX
```

## boards/foo/board.yml
```yaml
board:
  name: foo
  full_name: Feather STM32F405 Express
  vendor: adafruit
  socs:
    - name: stm32f405xx
```

## boards/test_stm32f405_feather/Kconfig.test_stm32f405_feather
```kconfig
# Copyright (c) 2020 Lucian Copeland for Adafruit Industries
# SPDX-License-Identifier: Apache-2.0

config BOARD_TEST_STM32F405_FEATHER
	select SOC_STM32F405XX
```

## boards/test_stm32f405_feather/board.yml
```yaml
board:
  name: test_stm32f405_feather
  full_name: Feather STM32F405 Express
  vendor: adafruit
  socs:
    - name: stm32f405xx
```
